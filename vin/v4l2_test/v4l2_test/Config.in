## vin/v4l2_test/v4l2_test/Config.in
```kconfig
config BR2_PACKAGE_V4L2_TEST
	bool "v4l2_test"
	depends on BR2_TOOLCHAIN_HAS_THREADS # libv4l
	depends on BR2_USE_MMU # libv4l
	depends on !BR2_STATIC_LIBS # libv4l
	depends on BR2_INSTALL_LIBSTDCPP # libv4l
	depends on BR2_TOOLCHAIN_HEADERS_AT_LEAST_3_0 # libv4l
	select BR2_PACKAGE_JPEG
	select BR2_PACKAGE_LIBV4L
	help
	  Utility for v4l2test JPEGs form V4L2 devices. This tool is
	  similar to v4l2grab available from libv4l contrib directory,
	  but provides additional features such as JPEG output.

comment "v4l2_test needs a toolchain w/ threads, dynamic library, C++ and headers >= 3.0"
	depends on BR2_USE_MMU
	depends on !BR2_TOOLCHAIN_HAS_THREADS || BR2_STATIC_LIBS \
		|| !BR2_INSTALL_LIBSTDCPP || !BR2_TOOLCHAIN_HEADERS_AT_LEAST_3_0
```
